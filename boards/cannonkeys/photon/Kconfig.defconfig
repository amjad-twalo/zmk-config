## boards/cannonkeys/photon/Kconfig.defconfig
```kconfig
# Copyright (c) 2024 CannonKeys LLC
# SPDX-License-Identifier: MIT

if BOARD_PHOTON

config ZMK_KEYBOARD_NAME
    default "Photon"



if USB_DEVICE_STACK

config USB_NRFX
    default y

endif # USB_DEVICE_STACK

config ZMK_BLE
    default y

config ZMK_USB
    default y if !ZMK_SPLIT || ZMK_SPLIT_ROLE_CENTRAL

if ZMK_RGB_UNDERGLOW

config ZMK_RGB_UNDERGLOW_HUE_START
    default 160

config ZMK_RGB_UNDERGLOW_EFF_START
    default 3

config ZMK_RGB_UNDERGLOW_BRT_MIN
    default 10

config ZMK_RGB_UNDERGLOW_BRT_MAX
    default 50

endif # ZMK_RGB_UNDERGLOW

endif # BOARD_PHOTON
```

## boards/cannonkeys/photon/photon_nrf52840_zmk_defconfig
```kconfig
# Copyright (c) 2024 CannonKeys LLC
# SPDX-License-Identifier: MIT


# Enable MPU
CONFIG_ARM_MPU=y

CONFIG_PINCTRL=y

# enable GPIO
CONFIG_GPIO=y

CONFIG_USE_DT_CODE_PARTITION=y
CONFIG_BUILD_OUTPUT_UF2=y

CONFIG_MPU_ALLOW_FLASH_WRITE=y
CONFIG_NVS=y
CONFIG_SETTINGS_NVS=y
CONFIG_FLASH=y
CONFIG_FLASH_PAGE_LAYOUT=y 
CONFIG_FLASH_MAP=y

CONFIG_ZMK_RGB_UNDERGLOW=y

# Official ZMK RGBLED Widget for battery/connection status
CONFIG_RGBLED_WIDGET=y

CONFIG_ZMK_SLEEP=y
```

## config/west.yml
```yaml
manifest:
  remotes:
    - name: zmkfirmware
      url-base: https://github.com/zmkfirmware
  projects:
    - name: zmk
      remote: zmkfirmware
      revision: 6e2ef41e022d555b10f116e395832913f71717b3
      import: app/west.yml
    - name: zmk-rgbled-widget
      url: https://github.com/caksoylar/zmk-rgbled-widget
      revision: e6b467792a1dabef8cfa5c9fd26bfefc9c16662b

  self:
    path: config
```
