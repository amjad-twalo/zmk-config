/*
 * Overlay for the Seeed XIAO BLE acting as the central USB dongle
 * for the Photon keyboard peripheral.
 *
 * The dongle has no physical keys — it receives key events from the
 * Photon over BLE and forwards them to the host via USB HID.
 * No kscan is needed on a pure split central.
 */

#include "../../cannonkeys/photon/photon-layout.dtsi"

/ {
    chosen {
        zmk,kscan = &mock_kscan;
        zmk,physical-layout = &physical_layout0;
    };

    aliases {
        led-red = &led0;
        led-green = &led1;
        led-blue = &led2;
    };


    mock_kscan: mock_kscan_0 {
        compatible = "zmk,kscan-mock";
        columns = <0>;
        rows = <0>;
        events = <0>;
    };

};
